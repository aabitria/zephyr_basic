## CMakeLists.txt
```
# CMakeLists.txt - root file for Zephyr freestanding project
cmake_minimum_required(VERSION 3.20.0)

# ZEPHYR_BASE is defined in zephyr-env.sh script
find_package(Zephyr REQUIRED HINTS $ENV{ZEPHYR_BASE})
project(zephyr_basic)

target_sources(app PRIVATE src/main.c)
```

## prj.conf
```kconfig
# Configuration file for this project

CONFIG_PRINTK=n
#CONFIG_STDOUT_CONSOLE
```

## dts/playground/props-basics.overlay
```dts
/ {
    aliases {
      alias-by-label = &label_with_props;
      alias-by-path = &{/node_with_props};
      alias-as-string = "/node_with_props";
    };
    
    chosen {
      chosen-by-label = &label_with_props;
      chosen-by-path = &{/node_with_props};
      chosen-as-string = "/node_with_props";
    };
    
    label_with_props: node_with_props {
      compatible = "custom-props-basics";
      existent-boolean;
      int = <1>;
      array = <1 second_value: 2 3>;
      uint8-array = [12 34];
      string = string_value: "foo bar baz";
      string-array = "foo", "bar", "baz";
      enum-int = <200>;
      enum-string = "whatever";
    };
};

/* aliases and chosen can refer to any node or label,
   it's just in this example it referred to the
   example node */
```

## dts/playground/props-phandle.overlay
```dts
/ /*{
    label_a: node_a { };
    
    node_refs {
      phandle-by-path = <&{/node_a}>;
      phandle-by-label = <&label_a>;
    };
}; */


/* {
    label_a: node_a { };
    
    node_refs {
      path-by-path = &{/node_a};
      path-by-label = &label_a;
    };
};*/


/*{
    label_a: node_a { };
    
    label_b: node_b { };
    
    node_refs {
      phandles = <&{/node_a} &label_b>;
  };
};*/


{
    label_a: node_a { 
      phandle-array-of-ref-cells = <2>;
    };
    label_b: node_b { 
      phandle-array-of-ref-cells = <1>;
    };
    node_refs {
      phandles = <&{/node_a} 1 2 &label_b 3>;
    };    
};
```

## dts/bindings/custom,props-basics.yaml
```yaml
description: Custom properties
compatible: "custom,props-basics"

properties:
  int:
    type: int
  string:
    type: string
    
# Template for every property binding    
#properties:
#  <property-name>:
#    type: <property-type>
#    # required: false -> omitted by convention if false
```

## dts/bindings/custom-props-basics.yaml
```yaml
description: Custom properties
compatible: "custom-props-basics"

properties:
  existent-boolean:
    type: boolean
  int:
    type: int
    required: true
  array:
    type: array
  uint8-array:
    type: uint8-array
  string:
    type: string
  string-array:
    type: string-array
  enum-int:
    type: int
    enum:
      - 100
      - 200
      - 300
  enum-string:
    type: string
    enum:
      - "whatever"
      - "works"
```

## src/main.c
```c
#include <zephyr/kernel.h>
#include <zephyr/devicetree.h>

#define SLEEP_TIME_MS   100U

// Node identifier by /aliases node.
// DT_ALIAS(alias) = DT_N_ALIAS_ ## alias
#define NODE_PROPS_ALIAS_BY_LABEL       DT_ALIAS(alias_by_label)        // direct from dt
#define NODE_PROPS_ALIAS_BY_PATH        DT_ALIAS(alias_by_path)
#define NODE_PROPS_ALIAS_BY_STRING      DT_ALIAS(alias_as_string)

// Node identifier by /chosen node.
// DT_CHOSEN(chosen) = DT_N_CHOSEN_ ## chosen
#define NODE_PROPS_CHOSEN_BY_LABEL      DT_CHOSEN(chosen_by_label)
#define NODE_PROPS_CHOSEN_BY_PATH       DT_CHOSEN(chosen_by_path)
#define NODE_PROPS_CHOSEN_AS_STRING     DT_CHOSEN(chosen_as_string)

#define NODE_PROPS_BY_LABEL             DT_NODELABEL(label_with_props)

#define PRINTK_STRING(node_id, prop, idx)                                       \
        do {                                                                    \
                printk("[%d] -- %s\n", idx, DT_PROP_BY_IDX(node_id, prop, idx));\
        } while (0);


typedef struct {
        bool boolean_exists;
        int32_t int_value;
        char *string_value;
        int32_t enum_int_value;
        char *enum_string_value;
} values_t;

/*
 * the properties here should be named such as those dashes in .dts is
 * replaced by _ !!
 * Remember, the property name is appended to the token in devicetree_gen.h!
 */
const values_t values = {
        .boolean_exists    = DT_PROP(NODE_PROPS_ALIAS_BY_LABEL, existent_boolean),
        .int_value         = DT_PROP(NODE_PROPS_ALIAS_BY_PATH, int),
        .string_value      = DT_PROP(NODE_PROPS_ALIAS_BY_STRING, string),
        .enum_int_value    = DT_PROP(NODE_PROPS_CHOSEN_BY_LABEL, enum_int),
        .enum_string_value = DT_PROP(NODE_PROPS_CHOSEN_BY_PATH, enum_string),
};

int main(void)
{
        printk("Message from freestanding project.\n");
        printk("DT values = {\n");
        printk("  .boolean_exists     = %d\n", values.boolean_exists);    // = 1
        printk("  .int_value          = %d\n", values.int_value);         // = 1
        printk("  .string_value       = %s\n", values.string_value);      // = "foo bar baz"
        printk("  .enum_int_value     = %d\n", values.enum_int_value);    // = 200
        printk("  .enum_string_value  = %s\n", values.enum_string_value); // = "whatever"
        printk("}\n");
        
        printk(
            "The index within enum-int of the selected value %d is %d.\n",
            values.enum_int_value,
            DT_ENUM_IDX(NODE_PROPS_CHOSEN_AS_STRING, enum_int));
            
        printk(
            "The index within 'enum_string' of the selected value '%s' is %d.\n",
            values.enum_string_value,
            DT_ENUM_IDX(NODE_PROPS_CHOSEN_AS_STRING, enum_string));
            
        /*
         *This executes PRINTK_STRING for each string element of string_array
         * property.
         */
        DT_FOREACH_PROP_ELEM(NODE_PROPS_BY_LABEL, string_array, PRINTK_STRING);
        
        const uint32_t cell_array[] = DT_PROP(NODE_PROPS_BY_LABEL, array);
        const uint8_t bytestring[] = DT_PROP(NODE_PROPS_BY_LABEL, uint8_array);

        const size_t cell_array_len = DT_PROP_LEN(NODE_PROPS_BY_LABEL, array);
        const size_t bytestring_len = DT_PROP_LEN(NODE_PROPS_BY_LABEL, uint8_array);
        
        if ((cell_array_len != (sizeof(cell_array) / sizeof(uint32_t))) ||
            (bytestring_len != (sizeof(bytestring) / sizeof(uint8_t)))) {
            /* unreachable since _LEN macro will always match the size */
            printk("Something's wrong!\n");
        }
        while (1) {
                k_msleep(SLEEP_TIME_MS); // Sleep for 100 ms.
        }
        
        return 0;
}
```
